## project/flash_video_mvp/main/Kconfig.projbuild
```kconfig
menu "Flash video MVP"
    config MVP_DIAGNOSTIC_BOOT
        bool "Wait for visual confirmation before playback"
        default n
endmenu
```

## project/flash_video_mvp/sdkconfig.defaults
```kconfig
CONFIG_IDF_TARGET="esp32p4"
CONFIG_ESP32P4_REV_MIN_301=y
CONFIG_ESPTOOLPY_FLASHSIZE_32MB=y
CONFIG_PARTITION_TABLE_CUSTOM=y
CONFIG_PARTITION_TABLE_CUSTOM_FILENAME="partitions.csv"
CONFIG_SPIRAM=y
CONFIG_SPIRAM_MODE_HEX=y
CONFIG_SPIRAM_SPEED_200M=y
CONFIG_FREERTOS_HZ=1000
CONFIG_ESP_MAIN_TASK_STACK_SIZE=8192
# CONFIG_MVP_DIAGNOSTIC_BOOT is not set
```
